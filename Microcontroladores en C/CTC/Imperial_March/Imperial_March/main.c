/*
 * Imperial_March.c
 *
 * Created: 14/05/2018 11:20:30 p. m.
 * Author : LuisFernando
 */ 

#define F_CPU 8000000
#include <util/delay.h>
#include <avr/io.h>
#include <avr/interrupt.h>
uint16_t contador=0,j=0;
const uint16_t Notas[132]={3034,65535,3034,65535,3034,65535,3822,65535,2551,65535,3034,65535,3822,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3034,65535};
const uint16_t Tiempo[132]={500,63,500,63,500,63,250,63,125,63,500,63,250,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125,63};
	
ISR(TIMER0_OVF_vect){
	TCNT0=130;
	j++;
	if (j>Tiempo[contador])
	{
		if (Notas[contador]==65535)
		{
			TCCR1A=(1<<COM1A1)|(0<<COM1A0)|(0<<COM1B1)|(0<<COM1B0)|(0<<FOC1A)|(0<<FOC1B)|(0<<WGM11)|(0<<WGM10);//Modo CTC cambiar a bajo.
		}
		else{
			TCCR1A=(0<<COM1A1)|(1<<COM1A0)|(0<<COM1B1)|(0<<COM1B0)|(0<<FOC1A)|(0<<FOC1B)|(0<<WGM11)|(0<<WGM10);//Modo CTC alternar estados.
		}
		OCR1A=Notas[contador];
		j=0;
		contador++;
		if(contador>132){
		contador=0;}
	}
}
int main(void)
{
	DDRD=(1<<PD5);
	///Configuracion Timer0 a 1ms en Modo Normal
	TCCR0=(0<<FOC0)|(0<<WGM00)|(0<<COM01)|(0<<COM00)|(0<<WGM01)|(0<<CS02)|(1<<CS01)|(1<<CS00);//Desconectar OC0,Modo Normal, con prescalador de 64.
	TIMSK=(0<<OCIE2)|(0<<TOIE2)|(0<<TICIE1)|(0<<OCIE1A)|(0<<OCIE1B)|(0<<TOIE1)|(0<<OCIE0)|(1<<TOIE0);//InterrupciСn por TOIE0.
	TCNT0=130;
	//Configuracion Timer 1 en CTC
	TCCR1A=(0<<COM1A1)|(1<<COM1A0)|(0<<COM1B1)|(0<<COM1B0)|(0<<FOC1A)|(0<<FOC1B)|(0<<WGM11)|(0<<WGM10);//Conectar OC1A y Modo CTC.
	TCCR1B=(0<<ICNC1)|(0<<ICES1)|(0<<5)|(0<<WGM13)|(1<<WGM12)|(0<<CS12)|(1<<CS11)|(0<<CS10);//Modo CTC y Prescalador a 8.
	TCNT1=0x0000;
	ICR1=0x0000;
	OCR1A=0x0000;
	OCR1B=0x0000;
	sei();
	/* Replace with your application code */
	while (1)
	{
		
	}
}

