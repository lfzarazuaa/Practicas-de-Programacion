/*
 * Generador_Funciones_4.c
 *
 * Created: 03/05/2018 10:42:27 p. m.
 * Author : LuisFernando
 */ 
#define F_CPU 16000000UL
#include <avr/io.h>
#include <avr/interrupt.h>
#include <Teclado_Mega.h>
#include <Lcd4bits_Mega.h>
uint16_t contador=0;
uint16_t i;
uint8_t Numero_Senal=0;
//Valores de PWM para generar la señal rampa.
const uint8_t Senal_Rampa[361]={51,51,52,52,52,53,53,54,54,55,55,55,56,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204,204};
//Valores de PWM para generar la señal seno.
const uint8_t Senal_Seno[361]={128,129,130,132,133,134,136,137,138,140,141,142,143,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126,128};
//Valores de PWM para generar la señal triangular.
const uint8_t Senal_Triangular[361]={51,52,52,53,54,55,56,57,58,58,59,60,61,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52,51};
//Valores de PWM para generar la señal circular.
const uint8_t Senal_Circular[361]={128,139,144,147,150,153,155,157,159,161,163,164,166,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116,128};
//Valores de PWM para generar la señal cuadrada.
const uint8_t Senal_Cuadrada[361]={51,51,51,51,51,51,51,51,51,51,51,51,51,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204,204};
#define muestras 361
const uint16_t Muestras=muestras;
const int Divisiones=20;
const uint16_t Maximo=4442;//2221;
const uint16_t Minimo=440;//220;
uint8_t Contador_Digito=0;
uint8_t Senal[muestras];
void Elegir_Senal(uint8_t Num_Senal);
void Imprimir_Senal(uint8_t Num_Senal);
void Presionar_Numero(uint8_t Tecla);
uint16_t Calcular_Tiempo(uint8_t Decenas,uint8_t Unidades,uint8_t Decimas);
uint16_t Calcular_Tiempo_b(uint8_t Decenas,uint8_t Unidades,uint8_t Decimas);
uint8_t Digito1,Digito2,Digito3;

void Obtener_Decimal(uint8_t Valor_Leido);
//Funciones del teclado cada vez que detecta una pulsación.
void Accion_Tecla_0(void){//Realiza la función si se presionó la tecla 0.
	Presionar_Numero('0');
}
void Accion_Tecla_1(void){//Realiza la función si se presionó la tecla 1.
	Presionar_Numero('1');
}
void Accion_Tecla_2(void){//Realiza la función si se presionó la tecla 2.
	Presionar_Numero('2');
}
void Accion_Tecla_3(void){//Realiza la función si se presionó la tecla 3.
	Presionar_Numero('3');
}
void Accion_Tecla_4(void){//Realiza la función si se presionó la tecla 4.
	Presionar_Numero('4');
}
void Accion_Tecla_5(void){//Realiza la función si se presionó la tecla 5.
	Presionar_Numero('5');
}
void Accion_Tecla_6(void){//Realiza la función si se presionó la tecla 6.
	Presionar_Numero('6');
}
void Accion_Tecla_7(void){//Realiza la función si se presionó la tecla 7.
	Presionar_Numero('7');
}
void Accion_Tecla_8(void){//Realiza la función si se presionó la tecla 8.
	Presionar_Numero('8');
}
void Accion_Tecla_9(void){//Realiza la función si se presionó la tecla 9.
	Presionar_Numero('9');
}
void Accion_Tecla_A(void){//Realiza la función si se presionó la tecla A.
     Numero_Senal=0;//Señal Rampa 
     Elegir_Senal(Numero_Senal);//Función que guarda en la memoria la señal a mostrar. 
}
void Accion_Tecla_B(void){//Realiza la función si se presionó la tecla B.
     Numero_Senal=1;//Señal Seno
     Elegir_Senal(Numero_Senal);//Función que guarda en la memoria la señal a mostrar.
}
void Accion_Tecla_C(void){//Realiza la función si se presionó la tecla C.
     Numero_Senal=2;//Señal Triangular
     Elegir_Senal(Numero_Senal);//Función que guarda en la memoria la señal a mostrar.
}
void Accion_Tecla_D(void){//Realiza la función si se presionó la tecla D.
     Numero_Senal=3;//Señal Circular
     Elegir_Senal(Numero_Senal);//Función que guarda en la memoria la señal a mostrar.
}
void Accion_Tecla_Ast(void){//Realiza la función si se presionó la tecla *.
	 //Ingresa la frecuencia puesta en el LCD
	 if (Contador_Digito>=3){//Si ya se ingresaron los 3 digitos pone la nueva frecuencia.
		 OCR1A=Calcular_Tiempo_b(Digito1,Digito2,Digito3);//Calcula la frecuencia en base a una tabla de datos.
		 OCR1B=Calcular_Tiempo(Digito1,Digito2,Digito3);//Calcula la frecuencia realizando las operaciones matematicas.
		 POS_LINEA1(7);
		 ENVIA_DATO('*');//Muestra la tecla presionada.
		 Contador_Digito=0;//Resetea el contador de dígitos.
     }
}
void Accion_Tecla_Num(void){//Realiza la función si se presionó la tecla Num.
	 Numero_Senal=4;//Señal Cuadrada
	 Elegir_Senal(Numero_Senal);//Función que guarda en la memoria la señal a mostrar.
}

uint16_t Calcular_Tiempo(uint8_t Decenas,uint8_t Unidades,uint8_t Decimas){
	Decenas-=0x30;//Convierte de ASCII a entero.
	Unidades-=0x30;//Convierte de ASCII a entero.
	Decimas-=0x30;//Convierte de ASCII a entero.
	float Freq=Decenas*10+Unidades+Decimas/10;//Regresa el valor de la frecuencia deseada.
	return 44321.32963988920/Freq-1;//Regresa el valor del contador conforme a la frecuencia deseada.
}
const uint16_t Val_OCRn[1000]={65535,65535,65535,65535,65535,65535,65535,63315,55401,49245,44320,40291,36933,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443,443};
uint16_t Calcular_Tiempo_b(uint8_t Decenas,uint8_t Unidades,uint8_t Decimas){//Función que regresa el valor del contador para la frecuencia.
	Decenas-=0x30;//Convierte de ASCII a entero.
	Unidades-=0x30;//Convierte de ASCII a entero.
	Decimas-=0x30;//Convierte de ASCII a entero.
	return Val_OCRn[Decenas*100+Unidades*10+Decimas];//Regresa el valor del contador conforme a la frecuencia deseada.
}
void Elegir_Senal(uint8_t Num_Senal){//Función que guarda en la memoria la señal a mostrar. 
	Numero_Senal=Num_Senal;
	switch(Num_Senal){
		case 0://Señal Rampa.
		for(i=0;i<Muestras;i++)(Senal[i]=Senal_Rampa[i]);
		break;
		case 1://Señal Seno.
		for(i=0;i<Muestras;i++)(Senal[i]=Senal_Seno[i]);
		break;
		case 2://Señal Triangular.
		for(i=0;i<Muestras;i++)(Senal[i]=Senal_Triangular[i]);
		break;
		case 3://Señal Circular.
		for(i=0;i<Muestras;i++)(Senal[i]=Senal_Circular[i]);
		break;
		default://Señal Cuadrada.
		for(i=0;i<Muestras;i++)(Senal[i]=Senal_Cuadrada[i]);
		break;
	}
	Imprimir_Senal(Numero_Senal);//Mostar la señal en el LCD.
}

void Imprimir_Senal(uint8_t Num_Senal){//Muestra en pantalla la señal desplegada en el osciloscopio.
    POS_LINEA2(1);
	switch(Num_Senal){
		case 0:
			  ENVIA_CADENA("Senal Rampa     ");
		break;
		case 1:
		      ENVIA_CADENA("Senal Seno      ");
		break;
		case 2:
		      ENVIA_CADENA("Senal Triangular");
		break;
		case 3:
		      ENVIA_CADENA("Senal Circular  ");
		break;
		default:
		      ENVIA_CADENA("Senal Cuadrada  ");
		break;
	}
}

void Presionar_Numero(uint8_t Tecla){//Función para ingresar los dígitos y mostrarlos en la LCD..
	switch (Contador_Digito)
	{
		case 0:
		Digito1=Tecla;
		LIMPIA_LCD();
		POS_LINEA1(3);
		ENVIA_DATO(Tecla);
		POS_LINEA1(5);
		ENVIA_DATO('.');
		Imprimir_Senal(Numero_Senal);
		POS_LINEA1(4);
		break;
		case 1:
		Digito2=Tecla;
		POS_LINEA1(4);
		ENVIA_DATO(Tecla);
		POS_LINEA1(6);
		break;
		case 2:
		Digito3=Tecla;
		POS_LINEA1(6);
		ENVIA_DATO(Tecla);
		break;
		default:
		Contador_Digito--;
		break;
	}
     Contador_Digito++;
}

ISR(TIMER1_COMPA_vect){//Funcion que cambia el valor del PWM conforme a la señal y frecuencia elegida.
	OCR0A=Senal[contador];//Cambia el valor del PWM segun la muestra de la señal.
	OCR0B=Senal[contador];//Cambia el valor del PWM segun la muestra de la señal.
	contador++;//Incrementa en 1 el contador,
	if (contador>=Muestras)(contador=0);//Restea el contador si se sobrepaso la ultima muestra.
}

int main(void)
{
	DDRB=(1<<PB7)|(1<<PB6);//Pines de PWM
	DDRD=(0<<PD2)|(0<<PD1)|(0<<PD0);
	PORTD=(1<<PD2)|(1<<PD1)|(1<<PD0);
	Inicializar_Teclado();
	//Configuracion Timer 0 en Fast PWM (16e6/256)
	TCCR0A=(1<<COM0A1)|(0<<COM0A0)|(1<<COM0B1)|(1<<COM0B0)|(0<<5)|(0<<4)|(1<<WGM01)|(1<<WGM00);//Conectar OC0A normal y OC0B invertido en modo PWM.
	TCCR0B=(0<<FOC0A)|(0<<FOC0B)|(0<<5)|(0<<4)|(0<<WGM02)|(0<<CS02)|(0<<CS01)|(1<<CS00);//Modo PWM y Prescalador a 1.
	TIMSK0=(0<<7)|(0<<6)|(0<<5)|(0<<4)|(0<<3)|(0<<OCIE0B)|(0<<OCIE0A)|(0<<TOIE0);//Sin Interrupciones.
	TCNT0=0x0000;
	OCR0A=0;
	OCR0B=0;
	//Configuracion Timer 1 en CTC (220-36.1991KHz y 2221-3.6004KHz)
	TCCR1A=(0<<COM1A1)|(0<<COM1A0)|(0<<COM1B1)|(0<<COM1B0)|(0<<COM1C1)|(0<<COM1C0)|(0<<WGM11)|(0<<WGM10);//Desconectar OC1A y Modo CTC.
	TCCR1B=(0<<ICNC1)|(0<<ICES1)|(0<<5)|(0<<WGM13)|(1<<WGM12)|(0<<CS12)|(0<<CS11)|(1<<CS10);//Modo CTC y Prescalador a 1.
	TCCR1C=(0<<FOC1A)|(0<<FOC1B)|(0<<FOC1C)|(0<<4)|(0<<3)|(0<<2)|(0<<1)|(0<<0);//Sin forzar comparaciones.
	TIMSK1=(0<<7)|(0<<6)|(0<<ICIE1)|(0<<4)|(0<<OCIE1C)|(0<<OCIE1B)|(1<<OCIE1A)|(0<<TOIE1);//Interrupciones por CompA.
	TCNT1=0x0000;
	ICR1=0x0000;
	OCR1A=440;
	OCR2A=0x0000;
	OCR1C=0x0000;
	//Cargar la señal Inicial
	//for(i=0;i<Muestras;i++)(Senal[i]=Senal_Rampa[i]);
	LCD_INICIALIZA(); 
	Elegir_Senal(Numero_Senal);//Función que guarda en la memoria la señal a mostrar.
	sei();
	while (1)
	{
	}
}

