/*
 * Generador_Funciones_3.c
 *
 * Created: 24/04/2018 12:41:08 p. m.
 * Author : LuisFernando
 */ 

#include <avr/io.h>
#include <Teclado_Mega.h>
uint16_t contador=0;
uint16_t i;
uint8_t Numero_Senal=0;

const uint8_t Senal_Rampa[361]={51,51,52,52,52,53,53,54,54,55,55,55,56,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204,204};
const uint8_t Senal_Seno[361]={128,129,130,132,133,134,136,137,138,140,141,142,143,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126,128};
const uint8_t Senal_Triangular[361]={51,52,52,53,54,55,56,57,58,58,59,60,61,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52,51};
const uint8_t Senal_Circular[361]={128,139,144,147,150,153,155,157,159,161,163,164,166,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116,128};
const uint8_t Senal_Cuadrada[361]={51,51,51,51,51,51,51,51,51,51,51,51,51,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204,204};
#define muestras 361
const uint16_t Muestras=muestras;
const int Divisiones=20;
const uint16_t Maximo=4442;//2221;
const uint16_t Minimo=440;//220;
uint8_t Incremento=5;
uint8_t Senal[muestras];
void Elegir_Senal(uint8_t Num_Senal);
void Cambiar_Senal(void);
void Decrementar_Tiempo(void);
void Incrementar_Tiempo(void);

void Accion_Tecla_0(void){
	Cambiar_Senal();
}
void Accion_Tecla_1(void){
	Numero_Senal=1;
	Elegir_Senal(Numero_Senal);
}
void Accion_Tecla_2(void){
	Numero_Senal=2;
	Elegir_Senal(Numero_Senal);
}
void Accion_Tecla_3(void){
	Numero_Senal=3;
	Elegir_Senal(Numero_Senal);
}
void Accion_Tecla_4(void){
	Numero_Senal=4;
	Elegir_Senal(Numero_Senal);
}
void Accion_Tecla_5(void){
	Numero_Senal=5;
	Elegir_Senal(Numero_Senal);
}
void Accion_Tecla_6(void){

}
void Accion_Tecla_7(void){
    
}
void Accion_Tecla_8(void){

}
void Accion_Tecla_9(void){

}
void Accion_Tecla_A(void){

}
void Accion_Tecla_B(void){

}
void Accion_Tecla_C(void){

}
void Accion_Tecla_D(void){

}
void Accion_Tecla_Ast(void){
    Incrementar_Tiempo();
}
void Accion_Tecla_Num(void){
    Decrementar_Tiempo();
}

void Cambiar_Senal(void){
	Numero_Senal++;
	Elegir_Senal(Numero_Senal);
	if (Numero_Senal==5)
	{
		Numero_Senal=255;
	}
}
void Incrementar_Tiempo(void){
	OCR1A=OCR1A+Incremento;
	if(OCR1A>Maximo){
		OCR1A=Maximo;
	}
	_delay_ms(400);
}
void Decrementar_Tiempo(void){
	OCR1A=OCR1A-Incremento;
	if(OCR1A<Minimo){
		OCR1A=Minimo;
	}
	_delay_ms(400);
}

void Elegir_Senal(uint8_t Num_Senal){
	Numero_Senal=Num_Senal;
	switch(Num_Senal){
		case 1:
		for(i=0;i<Muestras;i++)(Senal[i]=Senal_Rampa[i]);
		break;
		case 2:
		for(i=0;i<Muestras;i++)(Senal[i]=Senal_Seno[i]);
		break;
		case 3:
		for(i=0;i<Muestras;i++)(Senal[i]=Senal_Triangular[i]);
		break;
		case 4:
		for(i=0;i<Muestras;i++)(Senal[i]=Senal_Circular[i]);
		break;
		default:
		for(i=0;i<Muestras;i++)(Senal[i]=Senal_Cuadrada[i]);
		break;
	}
}

ISR(TIMER1_COMPA_vect){
	OCR0A=Senal[contador];
	OCR0B=Senal[contador];
	contador++;
	if (contador>=Muestras)(contador=0);
}

int main(void)
{
    DDRB=(1<<PB7)|(1<<PB6);//Pines de PWM
    DDRD=(0<<PD2)|(0<<PD1)|(0<<PD0);
    PORTD=(1<<PD2)|(1<<PD1)|(1<<PD0);
    Inicializar_Teclado();
    //Configuracion Timer 0 en Fast PWM (16e6/256)
    TCCR0A=(1<<COM0A1)|(0<<COM0A0)|(1<<COM0B1)|(1<<COM0B0)|(0<<5)|(0<<4)|(1<<WGM01)|(1<<WGM00);//Conectar OC0A normal y OC0B invertido en modo PWM.
    TCCR0B=(0<<FOC0A)|(0<<FOC0B)|(0<<5)|(0<<4)|(0<<WGM02)|(0<<CS02)|(0<<CS01)|(1<<CS00);//Modo PWM y Prescalador a 1.
    TIMSK0=(0<<7)|(0<<6)|(0<<5)|(0<<4)|(0<<3)|(0<<OCIE0B)|(0<<OCIE0A)|(0<<TOIE0);//Sin Interrupciones.
    TCNT0=0x0000;
    OCR0A=0;
    OCR0B=0;
    //Configuracion Timer 1 en CTC (220-36.1991KHz y 2221-3.6004KHz)
    TCCR1A=(0<<COM1A1)|(0<<COM1A0)|(0<<COM1B1)|(0<<COM1B0)|(0<<COM1C1)|(0<<COM1C0)|(0<<WGM11)|(0<<WGM10);//Desconectar OC1A y Modo CTC.
    TCCR1B=(0<<ICNC1)|(0<<ICES1)|(0<<5)|(0<<WGM13)|(1<<WGM12)|(0<<CS12)|(0<<CS11)|(1<<CS10);//Modo CTC y Prescalador a 1.
    TCCR1C=(0<<FOC1A)|(0<<FOC1B)|(0<<FOC1C)|(0<<4)|(0<<3)|(0<<2)|(0<<1)|(0<<0);//Sin forzar comparaciones.
    TIMSK1=(0<<7)|(0<<6)|(0<<ICIE1)|(0<<4)|(0<<OCIE1C)|(0<<OCIE1B)|(1<<OCIE1A)|(0<<TOIE1);//Interrupciones por CompA.
    TCNT1=0x0000;
    ICR1=0x0000;
    OCR1A=220;
    OCR2A=0x0000;
    OCR1C=0x0000;
	//Cargar la seсal Inicial
    Incremento=(Maximo-Minimo)/Divisiones;
    for(i=0;i<Muestras;i++)(Senal[i]=Senal_Rampa[i]);
    sei();
    while (1) 
    {
    }
}

